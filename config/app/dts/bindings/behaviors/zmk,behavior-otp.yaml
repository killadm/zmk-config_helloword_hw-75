## config/app/dts/bindings/behaviors/zmk,behavior-otp.yaml
```yaml
title: ZMK OTP behavior
description: Behavior that generates TOTP codes
compatible: "zmk,behavior-otp"

properties:
  label:
    type: string
    required: false
```

## config/dts/bindings/behaviors/zmk,behavior-otp.yaml
```yaml
# Copyright (c) 2024
# SPDX-License-Identifier: MIT

description: OTP (One-Time Password) behavior

compatible: "zmk,behavior-otp"

include: zero_param.yaml
```
