## config/app/Kconfig
```kconfig
# Copyright (c) 2022-2023 XiNGRZ
# SPDX-License-Identifier: MIT

rsource "usb_comm/Kconfig"

rsource "Kconfig.hid_mouse"
rsource "Kconfig.indicator"

config HW75_KEYMAP_REMAP
	bool "HW75 lightweight online keymap remap"
	depends on SETTINGS
	default y if BOARD_HW75_KEYBOARD
```

## config/boards/arm/hw75_keyboard/Kconfig.usb
```kconfig
# Copyright (c) 2022-2023 XiNGRZ
# SPDX-License-Identifier: MIT

config HW75_USB_COMM
	default y
	select HW75_USB_COMM_FEATURE_RGB
	select HW75_USB_COMM_FEATURE_KEYMAP if HW75_KEYMAP_REMAP

if HW75_USB_COMM

config HW75_USB_COMM_MAX_TX_MESSAGE_SIZE
	int
	default 64

config HW75_USB_COMM_MAX_RX_MESSAGE_SIZE
	int
	default 64

config HW75_USB_COMM_RX_QUEUE_SIZE
	int
	default 2 if HW75_KEYMAP_REMAP

config HW75_USB_COMM_MAX_BYTES_FIELD_SIZE
	int
	default 54 if HW75_KEYMAP_REMAP

config HW75_USB_COMM_THREAD_STACK_SIZE
	int
	default 768 if HW75_KEYMAP_REMAP

endif # HW75_USB_COMM
```

## config/boards/arm/hw75_keyboard/hw75_keyboard_defconfig
```kconfig
# Copyright (c) 2022-2023 XiNGRZ
# SPDX-License-Identifier: MIT

# SoC
CONFIG_SOC_SERIES_STM32F1X=y
CONFIG_SOC_STM32F103XB=y
CONFIG_CLOCK_CONTROL=y
CONFIG_PINCTRL=y

# RGB
CONFIG_ZMK_RGB_UNDERGLOW_EXT_POWER=n
CONFIG_ZMK_RGB_UNDERGLOW_AUTO_OFF_IDLE=y
CONFIG_ZMK_RGB_UNDERGLOW_BRT_MAX=15
CONFIG_HW75_INDICATOR_BRIGHTNESS_ACTIVE=255
CONFIG_HW75_INDICATOR_BRIGHTNESS_INACTIVE=10

# Storage
CONFIG_FLASH=y
CONFIG_FLASH_MAP=y
CONFIG_NVS=y
CONFIG_SETTINGS=y

# System
CONFIG_USE_DT_CODE_PARTITION=y
CONFIG_HEAP_MEM_POOL_SIZE=1024
CONFIG_MAIN_STACK_SIZE=768
CONFIG_SYSTEM_WORKQUEUE_STACK_SIZE=1280
CONFIG_ZMK_BEHAVIORS_QUEUE_SIZE=4
CONFIG_ZMK_BHV_STICKY_KEY_MAX_HELD=4
CONFIG_ZMK_LOW_PRIORITY_THREAD_STACK_SIZE=768

# USB
CONFIG_USB_DEVICE_MANUFACTURER="HelloWord"
CONFIG_USB_DEVICE_PRODUCT="HW-75 Keyboard"
CONFIG_USB_HID_DEVICE_COUNT=2
```
